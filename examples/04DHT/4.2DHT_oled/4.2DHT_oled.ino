#include <ESP8266WiFi.h>
#include <ESP8266WebServer.h>
#include <ESP8266mDNS.h>
#include <Wire.h>
#include <SFE_MicroOLED.h>
#include <DHT.h>
#include <iotbundle.h>

// 1 สร้าง object ชื่อ iot และกำหนดค่า(project)
#define PROJECT "DHT"
Iotbundle iot(PROJECT);

// 1.1.ใส่ข้อมูลไวไฟ
const char *ssid = "wifi_ssid";
const char *password = "wifi_pass";
const char *host = "dht";

// 1.2.ใส่ข้อมูล user ที่สมัครกับเว็บ iotkiddie.com
String email = "test@iotkiddie.com";
String pass = "12345678";

#define DHTPIN D7
// Uncomment whatever type you're using!
//#define DHTTYPE DHT11   // DHT 11
#define DHTTYPE DHT22 // DHT 22  (AM2302), AM2321
//#define DHTTYPE DHT21   // DHT 21 (AM2301)
DHT dht(DHTPIN, DHTTYPE);

#define PIN_RESET -1
#define DC_JUMPER 0
MicroOLED oled(PIN_RESET, DC_JUMPER);

uint8_t logo_bmp[] = {
    0x00, 0x00, 0x00, 0x00, 0x00, 0x00, 0x00, 0x00, 0x00, 0x00, 0x00, 0x00,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 0x00, 0x00};

unsigned long previousMillis = 0;

ESP8266WebServer server(80);
String serverIndex = "<form method='POST' action='/update' enctype='multipart/form-data'><input type='file' name='update'><input type='submit' value='Update'></form><p>ESP ID : " + String(ESP.getChipId()) + "</p>";

void setup()
{
    Serial.begin(115200);
    dht.begin();
    Wire.begin();

    WiFi.mode(WIFI_STA);
    WiFi.begin(ssid, password);
    while (WiFi.status() != WL_CONNECTED)
    {
        delay(500);
        Serial.print(".");
    }

    //------Display LOGO at start------
    oled.begin();
    oled.clear(PAGE);
    oled.clear(ALL);
    oled.drawBitmap(logo_bmp); // call the drawBitmap function and pass it the array from above
    oled.setFontType(0);
    oled.setCursor(0, 36);
    oled.print(" IoTbundle");
    oled.display();

    // ส่วนของ update ด้วย binary file
    if (WiFi.waitForConnectResult() == WL_CONNECTED)
    {
        MDNS.begin(host);
        server.on("/", HTTP_GET, []()
                  {
                server.sendHeader("Connection", "close");
                server.send(200, "text/html", serverIndex); });
        server.on(
            "/update", HTTP_POST, []()
            {
          server.sendHeader("Connection", "close");
          server.send(200, "text/plain", (Update.hasError()) ? "FAIL" : "OK");
          ESP.restart(); },
            []()
            {
                HTTPUpload &upload = server.upload();
                if (upload.status == UPLOAD_FILE_START)
                {
                    Serial.setDebugOutput(true);
                    WiFiUDP::stopAll();
                    Serial.printf("Update: %s\n", upload.filename.c_str());
                    uint32_t maxSketchSpace = (ESP.getFreeSketchSpace() - 0x1000) & 0xFFFFF000;
                    if (!Update.begin(maxSketchSpace))
                    { // start with max available size
                        Update.printError(Serial);
                    }
                }
                else if (upload.status == UPLOAD_FILE_WRITE)
                {
                    if (Update.write(upload.buf, upload.currentSize) != upload.currentSize)
                    {
                        Update.printError(Serial);
                    }
                }
                else if (upload.status == UPLOAD_FILE_END)
                {
                    if (Update.end(true))
                    { // true to set the size to the current progress
                        Serial.printf("Update Success: %u\nRebooting...\n", upload.totalSize);
                    }
                    else
                    {
                        Update.printError(Serial);
                    }
                    Serial.setDebugOutput(false);
                }
                yield();
            });
        server.begin();
        MDNS.addService("http", "tcp", 80);

        Serial.printf("Ready! Open http://%s.local in your browser\n", host);
    }
    else
    {
        Serial.println("WiFi Failed");
    }

    // 2 เริ่มเชื่อมต่อ หลังจากต่อไวไฟได้
    iot.begin(email, pass);
}

void loop()
{
    // 3 คอยจัดการ และส่งค่าให้เอง
    iot.handle();

    server.handleClient();
    MDNS.update();

    unsigned long currentMillis = millis();
    if (currentMillis - previousMillis >= 2000)
    { // run every 1 second
        previousMillis = currentMillis;
        //------get data from DHT------
        float humid = dht.readHumidity();
        float temp = dht.readTemperature();

        display_update(humid, temp);

        /*  4 เมื่อได้ค่าใหม่ ให้อัพเดทตามลำดับตามตัวอย่าง
            ตัวไลบรารี่รวบรวมและหาค่าเฉลี่ยส่งขึ้นเว็บให้เอง
            ถ้าค่าไหนไม่ต้องการส่งค่า ให้กำหนดค่าเป็น NAN   */
        iot.update(humid, temp);
    }
}

void display_update(float humid, float temp)
{
    //------Update OLED------
    oled.clear(PAGE);
    oled.setFontType(0);
    oled.setCursor(0, 0);
    oled.println("--DHT--\n\nH: " + String(humid,1) + " %\nT: " + String(temp,1) + " C");
    oled.display();

    // display data in serialmonitor
    Serial.println("Humidity: " + String(humid) + "%  Temperature: " + String(temp) + "°C ");
}